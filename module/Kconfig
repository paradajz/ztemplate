## module/Kconfig
```kconfig
menu "ztemplate"

module = ZTEMPLATE
module-str = ztemplate
source "subsys/logging/Kconfig.template.log_config"

rsource "src/led_toggler/Kconfig"

endmenu
```

## module/src/led_toggler/Kconfig
```kconfig
config ZTEMPLATE_LED_TOGGLER_LIB
    bool "LED toggler library"
    default n
    help
      Example library which configures and toggles built-in board LED.
```
